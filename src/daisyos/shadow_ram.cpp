/*
 * DaisyOS - main firmware for the Daisy computer.
 * Copyright (C) 2026 Joe Cassara
 *
 * This program is free software: you can redistribute it and/or modify
 * it under the terms of the GNU General Public License as published by
 * the Free Software Foundation, either version 3 of the License, or
 * (at your option) any later version.
 *
 * This program is distributed in the hope that it will be useful,
 * but WITHOUT ANY WARRANTY; without even the implied warranty of
 * MERCHANTABILITY or FITNESS FOR A PARTICULAR PURPOSE.  See the
 * GNU General Public License for more details.
 *
 * You should have received a copy of the GNU General Public License
 * along with this program.  If not, see <https://www.gnu.org/licenses/>.
 */

#include "shadow_ram.h"
#include "video_messages.h"
#include <Arduino.h>

// Total character cells on the screen, and the glyph table geometry.
#define VID_CELLS (VID_WIDTH * VID_HEIGHT)
const uint16_t kCharsPerSet = 256;
const uint8_t kGlyphRows = 8;


PROGMEM const byte charROMShadow[] = {
    0x00, 0xF0, 0x0F, 0xFF, 0x00, 0xF0, 0x0F, 0xFF, 0x00, 0xF0, 0x0F, 0xFF,
    0x00, 0xF0, 0x0F, 0xFF, 0x80, 0x01, 0xFF, 0x18, 0x18, 0x18, 0x00, 0x18,
    0xFF, 0x18, 0x00, 0x18, 0x00, 0x18, 0x00, 0x18, 0x00, 0x30, 0x6C, 0x6C,
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    0x00, 0x66, 0x00, 0x00, 0x00, 0x00, 0x00, 0x55};

typedef enum { AutoAdvance, ManualAdvance } CursorMode;

typedef enum { AutoScroll, ManualScroll } ScrollMode;

typedef struct {
  int8_t x;
  int8_t y;
} CursorLocation;

struct {
  uint8_t videomem[VID_CELLS];
  uint8_t attrbmem[VID_CELLS];
  CursorLocation cursor_location;
  CursorMode cursor_mode;
  ScrollMode scroll_mode;
  bool continue_line[40];
  bool reverse_mode;
  uint8_t char_defs[kCharsPerSet][kGlyphRows];
  uint8_t gfx_defs[kCharsPerSet][kGlyphRows];
} shadow_ram;

static const uint8_t mixedFwd[256] PROGMEM = {
    0, 0,   0,   0,   0,   0,   0,   0,   0,   0,   0,   0,   0,   0,   0,   0,
    0, 0,   176, 0,   177, 0,   178, 0,   179, 0,   180, 0,   181, 0,   182, 0,
    0, 183, 0,   0,   184, 185, 0,   0,   186, 187, 0,   0,   188, 189, 0,   0,
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    0, 0,   0,   0,   0,   0,   0,   0,   0,   0,   0,   0,   0,   0,   0,   0,
};

static const uint8_t mixedRev[50] PROGMEM = {
    0x12, 0x14, 0x16, 0x18, 0x1A, 0x1C, 0x1E, 0x21, 0x24, 0x25,
    0x28, 0x29, 0x2C, 0x2D, 0x34, 0x38, 0x3C, 0x41, 0x42, 0x43,
    0x48, 0x49, 0x4A, 0x4B, 0x52, 0x58, 0x5A, 0x61, 0x68, 0x69,
    0x78, 0x81, 0x82, 0x83, 0x84, 0x85, 0x86, 0x87, 0x92, 0x94,
    0x96, 0xA1, 0xA4, 0xA5, 0xB4, 0xC1, 0xC2, 0xC3, 0xD2, 0xE1,
};

// Decodes a block-graphic character into masks of which quadrants are solid and
// which are dithered. Non-graphic characters decode to empty.
static inline void extractPixelBits(uint8_t ch, uint8_t& solid,
                                    uint8_t& dither) {
  if (ch <= 15) {
    solid = ch;
    dither = 0;
  } else if (ch >= 160 && ch <= 175) {
    solid = 0;
    dither = ch - 160;
  } else if (ch >= 176 && ch <= 225) {
    uint8_t sd = pgm_read_byte(&mixedRev[ch - 176]);
    solid = sd >> 4;
    dither = sd & 0x0F;
  } else {
    solid = 0;
    dither = 0;
  }
}

// Inverse of extractPixelBits: the character code that renders a given mix of
// solid and dithered quadrants.
static inline uint8_t packPixelBits(uint8_t solid, uint8_t dither) {
  if (dither == 0) {
    return solid;
  }
  if (solid == 0) {
    return 160 + dither;
  }
  return pgm_read_byte(&mixedFwd[(solid << 4) | dither]);
}

// Sets up the local mirror of the video board's state. DaisyOS keeps a full
// copy of screen memory, attributes, and glyph definitions so it can read the
// screen back and compute updates without ever querying DaisyVideo, which is a
// write-only link. Also synthesises the mixed solid/dither glyphs absent from
// the ROM font.
void InitShadowRam(void) {
  memset(&shadow_ram, 0, sizeof(shadow_ram));
  shadow_ram.cursor_mode = AutoAdvance;
  shadow_ram.scroll_mode = AutoScroll;
  shadow_ram.reverse_mode = false;

  for (uint16_t ch = 0; ch < 256; ch++) {
    for (uint8_t row = 0; row < 8; row++) {
      uint8_t val = pgm_read_byte(&charROMShadow[row * 256 + ch]);
      shadow_ram.char_defs[ch][row] = val;
      shadow_ram.gfx_defs[ch][row] = val;
    }
  }

  for (uint8_t i = 0; i < 50; i++) {
    uint8_t sd = pgm_read_byte(&mixedRev[i]);
    uint8_t solidBits = sd >> 4, ditherBits = sd & 0x0F;
    uint8_t ch = 176 + i;
    for (uint8_t row = 0; row < 8; row++) {
      uint8_t leftBit = (row < 4) ? 0 : 2;
      uint8_t rightBit = (row < 4) ? 1 : 3;
      uint8_t leftState = (solidBits >> leftBit) & 1
                              ? 1
                              : ((ditherBits >> leftBit) & 1 ? 2 : 0);
      uint8_t rightState = (solidBits >> rightBit) & 1
                               ? 1
                               : ((ditherBits >> rightBit) & 1 ? 2 : 0);
      uint8_t lb = 0;
      if (leftState == 1) {
        lb = 0xF0;
      } else if (leftState == 2) {
        lb = (row & 1) ? 0x50 : 0xA0;
      }
      uint8_t rb = 0;
      if (rightState == 1) {
        rb = 0x0F;
      } else if (rightState == 2) {
        rb = (row & 1) ? 0x05 : 0x0A;
      }
      shadow_ram.char_defs[ch][row] = lb | rb;
      shadow_ram.gfx_defs[ch][row] = lb | rb;
    }
  }
}

// Selects whether newly written characters are reverse video.
void SetReverseMode(bool reverse) {
  shadow_ram.reverse_mode = reverse;
  VideoMsgSendSetReverseMode(reverse);
}

// True if newly written characters will be in reverse video.
bool GetReverseMode(void) { return shadow_ram.reverse_mode; }

// Inverts the entire display without touching per-cell attributes.
void SetReverseScreen(bool reverse) {
  shadow_ram.reverse_mode = reverse;
  memset(shadow_ram.attrbmem, reverse ? 0xFF : 0x00,
         sizeof(shadow_ram.attrbmem));
  VideoMsgSendReverseScreen(reverse);
}

// Scrolls the mirror up one row and blanks the bottom. The caller sends the
// matching command to the video board.
void Scrollscr(void) {
  uint8_t attrValue = shadow_ram.reverse_mode ? 0xFF : 0x00;
  for (uint8_t line = 1; line < VID_HEIGHT; line++) {
    memcpy(&shadow_ram.videomem[(line - 1) * VID_WIDTH],
           &shadow_ram.videomem[VID_WIDTH * line], VID_WIDTH);
    memcpy(&shadow_ram.attrbmem[(line - 1) * VID_WIDTH],
           &shadow_ram.attrbmem[VID_WIDTH * line], VID_WIDTH);
    shadow_ram.continue_line[line - 1] = shadow_ram.continue_line[line];
  }
  memset(&shadow_ram.videomem[(VID_HEIGHT - 1) * VID_WIDTH], 0x00, VID_WIDTH);
  memset(&shadow_ram.attrbmem[(VID_HEIGHT - 1) * VID_WIDTH], attrValue,
         VID_WIDTH);
  shadow_ram.continue_line[VID_HEIGHT - 1] = false;
}

// Fills the screen with one character and resets attributes.
void Clrscr(byte val) {
  memset(shadow_ram.videomem, val, sizeof(shadow_ram.videomem));
  memset(shadow_ram.attrbmem, shadow_ram.reverse_mode ? 0xFF : 0x00,
         sizeof(shadow_ram.attrbmem));
  memset(shadow_ram.continue_line, 0, sizeof(shadow_ram.continue_line));
  VideoMsgSendClearScreen(val);
}

// Writes a character to a cell without moving the cursor or changing the
// cell's attribute.
void PlotChar(uint8_t x, uint8_t y, uint8_t ch) {
  if (x < VID_WIDTH && y < VID_HEIGHT) {
    uint16_t cell = x + y * VID_WIDTH;
    shadow_ram.videomem[cell] = ch;
    VideoMsgSendPlotChar(x, y, ch);
  }
}

// Fills a run of cells, wrapping onto following rows.
void FillCells(uint8_t x, uint8_t y, uint8_t ch, uint8_t count) {
  if (count == 0 || x >= VID_WIDTH || y >= VID_HEIGHT) {
    return;
  }
  uint16_t cell = (uint16_t)x + (uint16_t)y * VID_WIDTH;
  uint16_t available = (VID_WIDTH * VID_HEIGHT) - cell;
  if (count > available) {
    count = (uint8_t)available;
  }
  if (count == 0) {
    return;
  }
  memset(&shadow_ram.videomem[cell], ch, count);
  memset(&shadow_ram.attrbmem[cell], shadow_ram.reverse_mode ? 0xFF : 0x00,
         count);
  VideoMsgSendFillCells(x, y, ch, count);
}

// Mirrors a rectangle fill locally, cycling the character range exactly as the
// video board does so the two copies stay in step.
void FillBlockShadow(uint8_t x, uint8_t y, uint8_t w, uint8_t h,
                     uint8_t startChar, uint8_t endChar) {
  uint8_t ch = startChar;
  uint8_t attrib = shadow_ram.reverse_mode ? 0xFF : 0x00;
  for (uint8_t row = 0; row < h && (y + row) < VID_HEIGHT; row++) {
    uint16_t cell = (uint16_t)x + (uint16_t)(y + row) * VID_WIDTH;
    for (uint8_t col = 0; col < w && (x + col) < VID_WIDTH; col++) {
      shadow_ram.videomem[cell + col] = ch;
      shadow_ram.attrbmem[cell + col] = attrib;
      if (ch == endChar) {
        ch = startChar;
      } else {
        ch++;
      }
    }
  }
}

// Writes one character at the cursor and advances it, wrapping and scrolling at
// the edges. Updates both the mirror and the display.
void Chrout(uint8_t ascii) {
  if (ascii == 13) {
    Newline();
    return;
  }
  VideoMsgSendChrOut(ascii);
  if (ascii <= 255) {
    uint16_t cell = shadow_ram.cursor_location.x +
                    (shadow_ram.cursor_location.y * VID_WIDTH);
    shadow_ram.videomem[cell] = ascii;
    shadow_ram.attrbmem[cell] = shadow_ram.reverse_mode ? 0xFF : 0x00;
    if (shadow_ram.cursor_mode == AutoAdvance) {
      shadow_ram.cursor_location.x++;
      if (shadow_ram.cursor_location.x >= VID_WIDTH) {
        shadow_ram.cursor_location.x = 0;
        shadow_ram.cursor_location.y++;
        if (shadow_ram.cursor_location.y >= VID_HEIGHT) {
          if (shadow_ram.scroll_mode == AutoScroll) {
            Scrollscr();
          }
          shadow_ram.cursor_location.x = 0;
          shadow_ram.cursor_location.y = VID_HEIGHT - 1;
        }
        shadow_ram.continue_line[shadow_ram.cursor_location.y - 1] = true;
        shadow_ram.continue_line[shadow_ram.cursor_location.y] = false;
        if (shadow_ram.cursor_location.y >= 2) {
          shadow_ram.continue_line[shadow_ram.cursor_location.y - 2] = false;
        }
      }
    }
  }
}

// Chrout with the target cell forced to reverse video.
void chrout_reverse(uint8_t ascii) {
  shadow_ram.attrbmem[shadow_ram.cursor_location.y * VID_WIDTH] = 0xff;
  Chrout(ascii);
}

// Moves the cursor, ignoring coordinates that fall off-screen.
void LocateCursor(int x, int y) {
  if (x != shadow_ram.cursor_location.x) {
    if (x >= 0 && x < VID_WIDTH) {
      shadow_ram.cursor_location.x = x;
    }
  }
  if (y != shadow_ram.cursor_location.y) {
    if (y >= 0 && y < VID_HEIGHT) {
      shadow_ram.cursor_location.y = y;
    }
  }
  VideoMsgSendLocateCursor(x, y);
}

// Writes a NUL-terminated string at the cursor.
void PrintStr(char* string) {
  while (*string) {
    Chrout(*string++);
  }
  delayMicroseconds(3000);
}
// Writes a string horizontally centred on a row.
void CenterStr(char* string, uint8_t y) {
  uint8_t x = 20 - (uint8_t)strlen(string) / 2;
  LocateCursor(x, y);
  PrintStr(string);
}

// Starts a new line, scrolling if that runs off the bottom.
void Newline(void) {
  VideoMsgSendNewline();
  delayMicroseconds(3000);
  delayMicroseconds(3000);
  shadow_ram.cursor_location.x = 0;
  uint8_t old_line = shadow_ram.cursor_location.y++;
  if (HasContinue(old_line)) {
    shadow_ram.cursor_location.y++;
    VideoMsgSendNewline();
  }
  if (shadow_ram.cursor_location.y >= VID_HEIGHT) {
    if (shadow_ram.scroll_mode == AutoScroll) {
      Scrollscr();
    }
    shadow_ram.cursor_location.x = 0;
    shadow_ram.cursor_location.y = VID_HEIGHT - 1;
  }
}

// Moves the cursor one cell, clamping at the screen edges.
void MoveCursor(CursorDirection direction) {
  VideoMsgSendCursorMove(direction);
  switch (direction) {
    case kCursorUp: {
      shadow_ram.cursor_location.y--;
      if (shadow_ram.cursor_location.y < 0) {
        shadow_ram.cursor_location.y = 0;
      }
      break;
    }
    case kCursorRight: {
      shadow_ram.cursor_location.x++;
      if (shadow_ram.cursor_location.x == VID_WIDTH) {
        if (shadow_ram.cursor_location.y == VID_HEIGHT - 1) {
          if (shadow_ram.scroll_mode == AutoScroll) {
            Scrollscr();
          }
          shadow_ram.cursor_location.x = 0;
        } else {
          shadow_ram.cursor_location.x = 0;
          shadow_ram.cursor_location.y++;
        }
      }
      break;
    }
    case kCursorDown: {
      shadow_ram.cursor_location.y++;
      if (shadow_ram.cursor_location.y == VID_HEIGHT) {
        if (shadow_ram.scroll_mode == AutoScroll) {
          Scrollscr();
        }
        shadow_ram.cursor_location.y = VID_HEIGHT - 1;
      }
      break;
    }
    case kCursorLeft: {
      shadow_ram.cursor_location.x--;
      if (shadow_ram.cursor_location.x < 0) {
        if (shadow_ram.cursor_location.y != 0) {
          shadow_ram.cursor_location.x = VID_WIDTH - 1;
          shadow_ram.cursor_location.y--;
        } else {
          shadow_ram.cursor_location.x = 0;
        }
      }
      break;
    }
    default:
      break;
  }
}

// Inverts the cursor cell -- this is how the cursor is drawn, so no character
// underneath needs saving.
void ToggleAttribute(void) {
  uint16_t cell =
      (40 * shadow_ram.cursor_location.y) + shadow_ram.cursor_location.x;
  shadow_ram.attrbmem[cell] = ~shadow_ram.attrbmem[cell];
  VideoMsgSendPutAttribsAtCell(cell, (char*)&shadow_ram.attrbmem[cell], 1);
}

// Writes a run of characters at an absolute cell index.
void PutStringAt(uint16_t vidmemcell, char* str, uint8_t len) {
  VideoMsgSendPutStringAtCell(vidmemcell, str, len);
  memcpy(shadow_ram.videomem + vidmemcell, str, len);
}

// Writes a run of attribute bytes, leaving characters untouched.
void PutAttribAt(uint16_t vidmemcell, char* str, uint8_t len) {
  VideoMsgSendPutAttribsAtCell(vidmemcell, str, len);
  memcpy(shadow_ram.attrbmem + vidmemcell, str, len);
}

// Returns the cursor cell to normal video.
void ClearAttribute(void) {
  uint16_t cell =
      (40 * shadow_ram.cursor_location.y) + shadow_ram.cursor_location.x;
  shadow_ram.attrbmem[cell] = shadow_ram.reverse_mode ? 0xFF : 0x00;
  VideoMsgSendPutAttribsAtCell(cell, (char*)&shadow_ram.attrbmem[cell], 1);
}

// Enables or disables automatic scrolling at the bottom of the screen.
void SetScrollLock(bool en) {
  shadow_ram.scroll_mode = en ? ManualScroll : AutoScroll;
  VideoMsgSendSetScrollLock(en);
}

// True if automatic scrolling is disabled.
bool GetScrollLock(void) { return shadow_ram.scroll_mode == ManualScroll; }

// Reads a screen row out of the mirror as a NUL-terminated string, mapping the
// blank cell code to a space so the caller gets printable text.
bool GetVideoRamLine(uint8_t line, char* str) {
  memcpy(str, &shadow_ram.videomem[line * VID_WIDTH], VID_WIDTH);
  for (uint8_t i = 0; i < VID_WIDTH; i++) {
    if (str[i] == 0) {
      str[i] = ' ';
    }
  }
  str[VID_WIDTH] = '\0';
}

// True if this row is logically continued on the next -- a long program line
// that wrapped.
bool HasContinue(uint8_t line) { return shadow_ram.continue_line[line]; }

// Breaks the continuation link from this row to the next.
void ClearContinue(uint8_t line) { shadow_ram.continue_line[line] = false; }

// Row the cursor is on.
uint8_t GetCurrentLine(void) { return shadow_ram.cursor_location.y; }

// Cursor column.
uint8_t GetCursorX(void) { return shadow_ram.cursor_location.x; }

// Cursor row.
uint8_t GetCursorY(void) { return shadow_ram.cursor_location.y; }

// Writes a length-counted run of text from the cursor, scrolling as it fills
// the screen and batching each row into a single video message rather than one
// message per character.
void WriteString(const char* str, uint16_t len) {
  if (len > 1000) {
    len = 1000;
  }

  uint16_t cursor_cell =
      shadow_ram.cursor_location.y * VID_WIDTH + shadow_ram.cursor_location.x;
  uint16_t remaining = len;
  const char* ptr = str;

  while (remaining > 0) {
    uint16_t space_left = (VID_WIDTH * VID_HEIGHT) - cursor_cell;

    if (space_left == 0) {
      Scrollscr();
      VideoMsgSendScrollScreen();
      cursor_cell = (VID_HEIGHT - 1) * VID_WIDTH;
      space_left = VID_WIDTH;
    }

    uint16_t to_write = (remaining < space_left) ? remaining : space_left;

    uint16_t written = 0;
    while (written < to_write) {
      uint8_t chunk_size =
          ((to_write - written) > 58) ? 58 : (to_write - written);
      PutStringAt(cursor_cell + written, (char*)(ptr + written), chunk_size);
      memset(&shadow_ram.attrbmem[cursor_cell + written],
             shadow_ram.reverse_mode ? 0xFF : 0x00, chunk_size);
      written += chunk_size;
    }

    cursor_cell += to_write;
    ptr += to_write;
    remaining -= to_write;

    if (remaining > 0 && cursor_cell >= (VID_WIDTH * VID_HEIGHT)) {
      Scrollscr();
      VideoMsgSendScrollScreen();
      cursor_cell = (VID_HEIGHT - 1) * VID_WIDTH;
    }
  }

  shadow_ram.cursor_location.x = cursor_cell % VID_WIDTH;
  shadow_ram.cursor_location.y = cursor_cell / VID_WIDTH;

  VideoMsgSendLocateCursor(shadow_ram.cursor_location.x,
                           shadow_ram.cursor_location.y);
}

// Inserts a character at the cursor, pushing the rest of the line right. If the
// line already continues onto the next row the overflow is carried into it;
// otherwise a new continuation row is started, so long program lines survive
// editing in the middle.
void InsertCharAtCursor(uint8_t ch) {
  uint8_t x = shadow_ram.cursor_location.x;
  uint8_t y = shadow_ram.cursor_location.y;
  uint16_t lineStart = y * VID_WIDTH;

  uint8_t overflow = shadow_ram.videomem[lineStart + VID_WIDTH - 1];

  for (int i = VID_WIDTH - 1; i > x; i--) {
    shadow_ram.videomem[lineStart + i] = shadow_ram.videomem[lineStart + i - 1];
    shadow_ram.attrbmem[lineStart + i] = shadow_ram.attrbmem[lineStart + i - 1];
  }

  shadow_ram.videomem[lineStart + x] = ch;
  shadow_ram.attrbmem[lineStart + x] = shadow_ram.reverse_mode ? 0xFF : 0x00;

  VideoMsgSendPutStringAtCell(
      lineStart + x, (char*)&shadow_ram.videomem[lineStart + x], VID_WIDTH - x);

  bool hasExistingContinue = shadow_ram.continue_line[y];
  bool isAlreadyContinuation = (y > 0) && shadow_ram.continue_line[y - 1];
  bool canCreateContinue = !isAlreadyContinuation && (y < VID_HEIGHT - 1);

  if (hasExistingContinue) {
    uint16_t nextLineStart = (y + 1) * VID_WIDTH;

    for (int i = VID_WIDTH - 1; i > 0; i--) {
      shadow_ram.videomem[nextLineStart + i] =
          shadow_ram.videomem[nextLineStart + i - 1];
      shadow_ram.attrbmem[nextLineStart + i] =
          shadow_ram.attrbmem[nextLineStart + i - 1];
    }

    shadow_ram.videomem[nextLineStart] = overflow;
    shadow_ram.attrbmem[nextLineStart] = 0;

    VideoMsgSendPutStringAtCell(
        nextLineStart, (char*)&shadow_ram.videomem[nextLineStart], VID_WIDTH);
  } else if (canCreateContinue && overflow != ' ' && overflow != 0) {
    uint16_t nextLineStart = (y + 1) * VID_WIDTH;

    for (int i = VID_WIDTH - 1; i > 0; i--) {
      shadow_ram.videomem[nextLineStart + i] =
          shadow_ram.videomem[nextLineStart + i - 1];
      shadow_ram.attrbmem[nextLineStart + i] =
          shadow_ram.attrbmem[nextLineStart + i - 1];
    }

    shadow_ram.videomem[nextLineStart] = overflow;
    shadow_ram.attrbmem[nextLineStart] = 0;

    shadow_ram.continue_line[y] = true;
    shadow_ram.continue_line[y + 1] = false;

    VideoMsgSendPutStringAtCell(
        nextLineStart, (char*)&shadow_ram.videomem[nextLineStart], VID_WIDTH);
  }

  shadow_ram.cursor_location.x++;
  if (shadow_ram.cursor_location.x >= VID_WIDTH) {
    if (shadow_ram.continue_line[y] && y < VID_HEIGHT - 1) {
      shadow_ram.cursor_location.x = 0;
      shadow_ram.cursor_location.y++;
    } else {
      shadow_ram.cursor_location.x = VID_WIDTH - 1;
    }
  }
  VideoMsgSendLocateCursor(shadow_ram.cursor_location.x,
                           shadow_ram.cursor_location.y);
}

// Deletes the character at the cursor, pulling the rest of the line left and
// drawing back any text from a continuation row.
void DeleteCharAtCursor(void) {
  uint8_t x = shadow_ram.cursor_location.x;
  uint8_t y = shadow_ram.cursor_location.y;
  uint16_t lineStart = y * VID_WIDTH;

  for (int i = x; i < VID_WIDTH - 1; i++) {
    shadow_ram.videomem[lineStart + i] = shadow_ram.videomem[lineStart + i + 1];
    shadow_ram.attrbmem[lineStart + i] = shadow_ram.attrbmem[lineStart + i + 1];
  }

  if (shadow_ram.continue_line[y] && y < VID_HEIGHT - 1) {
    uint16_t nextStart = (y + 1) * VID_WIDTH;
    shadow_ram.videomem[lineStart + VID_WIDTH - 1] =
        shadow_ram.videomem[nextStart];
    shadow_ram.attrbmem[lineStart + VID_WIDTH - 1] =
        shadow_ram.attrbmem[nextStart];

    for (int i = 0; i < VID_WIDTH - 1; i++) {
      shadow_ram.videomem[nextStart + i] =
          shadow_ram.videomem[nextStart + i + 1];
      shadow_ram.attrbmem[nextStart + i] =
          shadow_ram.attrbmem[nextStart + i + 1];
    }
    shadow_ram.videomem[nextStart + VID_WIDTH - 1] = ' ';
    shadow_ram.attrbmem[nextStart + VID_WIDTH - 1] =
        shadow_ram.reverse_mode ? 0xFF : 0x00;

    VideoMsgSendPutStringAtCell(lineStart + x,
                                (char*)&shadow_ram.videomem[lineStart + x],
                                VID_WIDTH - x);
    VideoMsgSendPutStringAtCell(
        nextStart, (char*)&shadow_ram.videomem[nextStart], VID_WIDTH);
  } else {
    shadow_ram.videomem[lineStart + VID_WIDTH - 1] = ' ';
    shadow_ram.attrbmem[lineStart + VID_WIDTH - 1] =
        shadow_ram.reverse_mode ? 0xFF : 0x00;

    VideoMsgSendPutStringAtCell(lineStart + x,
                                (char*)&shadow_ram.videomem[lineStart + x],
                                VID_WIDTH - x);
  }
}

// Switches one row between the text and graphics character sets. The selection
// lives in the low bits of the row's first attribute byte.
void SetLineGfxMode(uint8_t line, bool isGfx) {
  if (line >= VID_HEIGHT) {
    return;
  }

  uint16_t lineStart = line * VID_WIDTH;

  if (isGfx) {
    shadow_ram.attrbmem[lineStart] |= 0x01;
  } else {
    shadow_ram.attrbmem[lineStart] &= ~0x01;
  }

  VideoMsgSendPutAttribsAtCell(lineStart,
                               (char*)&shadow_ram.attrbmem[lineStart], 1);
}

// Rotates a band of rows sideways with wraparound, normalising the shift so any
// direction value works.
void ScrollX(uint8_t y, uint8_t height, int8_t direction) {
  if (y >= VID_HEIGHT || height == 0 || direction == 0) {
    return;
  }
  int s = (int)direction % (int)VID_WIDTH;
  if (s < 0) s += VID_WIDTH;
  uint8_t shift = (uint8_t)s;
  uint8_t tmp[VID_WIDTH];
  for (uint8_t row = 0; row < height; row++) {
    uint8_t cy = y + row;
    if (cy >= VID_HEIGHT) {
      break;
    }
    uint8_t* line = &shadow_ram.videomem[cy * VID_WIDTH];
    memcpy(tmp, line, VID_WIDTH);
    memcpy(line + shift, tmp, VID_WIDTH - shift);
    memcpy(line, tmp + VID_WIDTH - shift, shift);
  }
  VideoMsgSendScrollX(y, height, direction);
}

// Reads a glyph's current bitmap from the mirror.
void GetCharDef(uint8_t ch, uint8_t* bitrows) {
  memcpy(bitrows, shadow_ram.char_defs[ch], 8);
}

// Reads a glyph's original ROM bitmap, ignoring any redefinition.
void GetCharROMDef(uint8_t ch, uint8_t* bitrows) {
  for (uint8_t row = 0; row < 8; row++) {
    bitrows[row] = pgm_read_byte(&charROMShadow[row * 256 + ch]);
  }
}

// Restores one text glyph in the mirror from ROM.
void ResetCharDef(uint8_t ch) { GetCharROMDef(ch, shadow_ram.char_defs[ch]); }

// Records a redefined glyph in the mirror.
void SetCharDef(uint8_t ch, const uint8_t* bitrows) {
  memcpy(shadow_ram.char_defs[ch], bitrows, 8);
}

// Reads a glyph from the graphics character set.
void GetGfxDef(uint8_t ch, uint8_t* bitrows) {
  memcpy(bitrows, shadow_ram.gfx_defs[ch], 8);
}

// Records a redefined graphics-set glyph.
void SetGfxDef(uint8_t ch, const uint8_t* bitrows) {
  memcpy(shadow_ram.gfx_defs[ch], bitrows, 8);
}

// Restores one graphics glyph in the mirror from ROM.
void ResetGfxDef(uint8_t ch) { GetCharROMDef(ch, shadow_ram.gfx_defs[ch]); }

// Character currently in a cell, read from the mirror.
uint8_t GetCharAt(uint8_t x, uint8_t y) {
  if (x >= VID_WIDTH || y >= VID_HEIGHT) {
    return 0;
  }
  return shadow_ram.videomem[x + y * VID_WIDTH];
}

// Sets one cell's video attribute without changing its character.
void SetAttribAt(uint8_t x, uint8_t y, uint8_t reversed) {
  if (x >= VID_WIDTH || y >= VID_HEIGHT) {
    return;
  }
  uint16_t cell = (uint16_t)x + (uint16_t)y * VID_WIDTH;
  uint8_t attr = reversed ? 0xFF : 0x00;
  shadow_ram.attrbmem[cell] = attr;
  VideoMsgSendPutAttribsAtCell(cell, (char*)&shadow_ram.attrbmem[cell], 1);
}

// Reads one cell's video attribute.
uint8_t GetAttribAt(uint8_t x, uint8_t y) {
  if (x >= VID_WIDTH || y >= VID_HEIGHT) {
    return 0;
  }
  return shadow_ram.attrbmem[x + y * VID_WIDTH] ? 1 : 0;
}

// Updates one pixel in the mirror only, for callers that will send their own
// batched drawing command.
void UpdateShadowPixel(uint8_t px, uint8_t py, uint8_t on) {
  uint8_t cx = px >> 1;
  uint8_t cy = py >> 1;
  if (cx >= VID_WIDTH || cy >= VID_HEIGHT) {
    return;
  }
  uint16_t cell = cx + cy * VID_WIDTH;
  uint8_t solid, dither;
  extractPixelBits(shadow_ram.videomem[cell], solid, dither);
  uint8_t mask = 1 << ((px & 1) | ((py & 1) << 1));
  solid &= ~mask;
  dither &= ~mask;
  if (on == 1) {
    solid |= mask;
  } else if (on == 2) {
    dither |= mask;
  }
  shadow_ram.videomem[cell] = packPixelBits(solid, dither);
}

// Sets one pixel in both the mirror and the display. Reads the cell's existing
// quadrants first so the other three pixels sharing it are preserved.
void PlotPixel(uint8_t px, uint8_t py, uint8_t on) {
  uint8_t cx = px >> 1;
  uint8_t cy = py >> 1;
  if (cx >= VID_WIDTH || cy >= VID_HEIGHT) {
    return;
  }
  uint16_t cell = cx + cy * VID_WIDTH;
  uint8_t solid, dither;
  extractPixelBits(shadow_ram.videomem[cell], solid, dither);
  uint8_t mask = 1 << ((px & 1) | ((py & 1) << 1));
  solid &= ~mask;
  dither &= ~mask;
  if (on == 1) {
    solid |= mask;
  } else if (on == 2) {
    dither |= mask;
  }
  shadow_ram.videomem[cell] = packPixelBits(solid, dither);
  VideoMsgSendSetPixel(px, py, on);
}

// Reads a pixel back as off, solid, or dithered.
uint8_t ReadPixelState(uint8_t px, uint8_t py) {
  uint8_t cx = px >> 1;
  uint8_t cy = py >> 1;
  if (cx >= VID_WIDTH || cy >= VID_HEIGHT) {
    return 0;
  }
  uint8_t ch = shadow_ram.videomem[cx + cy * VID_WIDTH];
  uint8_t solid, dither;
  extractPixelBits(ch, solid, dither);
  uint8_t mask = 1 << ((px & 1) | ((py & 1) << 1));
  if (solid & mask) {
    return 1;
  }
  if (dither & mask) {
    return 2;
  }
  return 0;
}
